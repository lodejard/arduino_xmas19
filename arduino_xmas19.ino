#include "SPI.h"
#include "Wire.h"
#include "Adafruit_GFX.h"
#include "Adafruit_SSD1306.h"
#include "Fonts/FreeSerif12pt7b.h"
#include "Fonts/Picopixel.h"

#define SCREEN_WIDTH 128 // OLED display width, in pixels
#define SCREEN_HEIGHT 64 // OLED display height, in pixels
// Declaration for SSD1306 display connected using software SPI (default case):
#define OLED_MOSI   9 //2
#define OLED_CLK   10 //3
#define OLED_DC    11 //4
#define OLED_CS    12 //5
#define OLED_RESET 13 //6
Adafruit_SSD1306 display(SCREEN_WIDTH, SCREEN_HEIGHT,
 OLED_MOSI, OLED_CLK, OLED_DC, OLED_RESET, OLED_CS);
/* Comment out above, uncomment this block to use hardware SPI
#define OLED_DC     6
#define OLED_CS     7
#define OLED_RESET  8
Adafruit_SSD1306 display(SCREEN_WIDTH, SCREEN_HEIGHT,
 &SPI, OLED_DC, OLED_RESET, OLED_CS);
*/
#define NUMFLAKES     15 // Number of snowflakes in the animation example
#define LOGO_HEIGHT   4
#define LOGO_WIDTH    4
static const unsigned char PROGMEM logo_tree[] =
{
   0x00, 0x00, 0x00, 0x00, 0x00, 0x00, 0x00, 0x00, 0x00, 0x00, 0x00, 0x00, 0x00, 0x00, 0x00, 0x00, 
   0x00, 0x00, 0x00, 0x00, 0x00, 0x00, 0x00, 0x00, 0x00, 0x00, 0x00, 0x03, 0x80, 0x00, 0x00, 0x00, 
   0x00, 0x00, 0x00, 0x00, 0x00, 0x00, 0x00, 0x00, 0x00, 0x00, 0x00, 0x07, 0xc0, 0x00, 0x00, 0x00, 
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   0x00, 0x00, 0x00, 0x00, 0x00, 0x00, 0x00, 0x00, 0x00, 0x00, 0x00, 0x00, 0x00, 0x00, 0x00, 0x00
};

static const unsigned char PROGMEM logo_bmp[] =
{     
   0x60, 
   0xf0, 
   0xf0, 
   0x60
};

struct Poem { 
  const char* title1; 
  const char* title2; 
  const char* body; 
};

#define POEM_COUNT 3

Poem poems[POEM_COUNT] = {
  {
    "Christmas Bells",
    "",
    "I heard the bells on Christmas Day    "
    "Their old, familiar carols play,    "
    "And wild and sweet    "
    "The words repeat    "
    "Of peace on earth, good-will to men!"
  },
  {
    "Stopping by Woods",
    "on a Snowy Evening",
    
    "Whose woods these are I think I know.    "
    "His house is in the village though;    "
    "He will not see me stopping here    "
    "To watch his woods fill up with snow.    "
    "        "
    "My little horse must think it queer    "
    "To stop without a farmhouse near    "
    "Between the woods and frozen lake    "
    "The darkest evening of the year.    "
    "        "
    "He gives his harness bells a shake    "
    "To ask if there is some mistake.    "
    "The only other sound’s the sweep    "
    "Of easy wind and downy flake.    "
    "        "
    "The woods are lovely, dark and deep,    "
    "But I have promises to keep,    "
    "And miles to go before I sleep,    "  
    "And miles to go before I sleep."
  },
  {
    "Mistletoe",
    "",
    "Sitting under the mistletoe    "
    "(Pale-green, fairy mistletoe),    "
    "One last candle burning low,    "
    "All the sleepy dancers gone,    "
    "Just one candle burning on,    "
    "Shadows lurking everywhere:    "
    "Some one came, and kissed me there.    "
    "        "
    "Tired I was; my head would go    "
    "Nodding under the mistletoe    "
    "(Pale-green, fairy mistletoe),    "
    "No footsteps came, no voice, but only,    "
    "Just as I sat there, sleepy, lonely,    "
    "Stooped in the still and shadowy air    "
    "Lips unseen—and kissed me there."
  }
};


void setup() {
 Serial.begin(9600);
 Serial.println(F("Ornament is starting"));
 randomSeed(analogRead(0));

 // SSD1306_SWITCHCAPVCC = generate display voltage from 3.3V internally
 if (!display.begin(SSD1306_SWITCHCAPVCC)) {
   Serial.println(F("SSD1306 allocation failed"));
   for(;;); // Don't proceed, loop forever
 }

 display.clearDisplay();
 display.display();

 Serial.print(F("Display width: "));
 Serial.print(display.width(), DEC);
 Serial.print(F(" height: "));
 Serial.println(display.height(), DEC);

 setupanimate(); 
 setupscroller();
}

void loop() {
//  unsigned long ms = millis();
  display.clearDisplay();

  loopanimate(); // Animate bitmaps
  loopscroller(); // Animate text

//  ms = millis() - ms;
//  display.setCursor(30, 15);
//  display.print(ms, DEC);
  display.display();
}

///////////////////////////////////////////////////////////////////////////////////////////////////////////////////////////////////////////////////////////////////
#define XPOS   0 // Indexes into the 'icons' array in function below
#define YPOS   1
#define DELTAY 2

int icons[NUMFLAKES][3];

unsigned long animate_last_ms;

void setupanimate() {
 // Initialize 'snowflake' positions
 for(int f=0; f< NUMFLAKES; f++) {
   icons[f][XPOS]   = random(1 - LOGO_WIDTH, display.width());
   icons[f][YPOS]   = -LOGO_HEIGHT*30;
   icons[f][DELTAY] = random(1, 6);
 }

 animate_last_ms = millis();
}

void loopanimate() {
  long tick_ms = (long)(millis() - animate_last_ms);
  while (tick_ms > 5) {
    tickanimate();
    tick_ms -= 5;
    animate_last_ms += 5;
  }
  drawanimate(logo_bmp, LOGO_WIDTH, LOGO_HEIGHT);
}

void tickanimate() {
   // Then update coordinates of each flake...
   for(int f=0; f< NUMFLAKES; f++) { 
    icons[f][YPOS] += icons[f][DELTAY]; 
    // If snowflake is off the bottom of the screen... 
    if (icons[f][YPOS] >= display.width()*30) {
       // Reinitialize to a random position, just off the top
       icons[f][XPOS]   = random(1 - LOGO_WIDTH, display.width());
       icons[f][YPOS]   = -LOGO_HEIGHT*30;
       icons[f][DELTAY] = random(1, 6);
     }
   }
}

void drawanimate(const uint8_t *bitmap, uint8_t w, uint8_t h) {
 display.drawBitmap(0,0,logo_tree, 128, 64, 1);
 // Draw each snowflake:
 for(int f=0; f< NUMFLAKES; f++) {
   display.drawBitmap( icons[f][YPOS]/30,icons[f][XPOS], bitmap, 4, 4, WHITE);
 }
}

unsigned long scroller_last_ms;
int scroller_ms;
int scroller_start_x;
int scroller_x;
int scroller_x00;
int scroller_y;
int scroller_dx00;
int scroller_line;
const char* scroller_str;
bool scroller_next_line;

void setupscroller() {
  display.setRotation(3);
  display.setTextWrap(false);
  display.setTextSize(1);      // Normal 1:1 pixel scale
  display.setTextColor(SSD1306_WHITE); // Draw white text
  display.cp437(true);         // Use full 256 char 'Code Page 437' font
  scroller_start_x = display.width();
  display.setRotation(0);

  scroller_ms = 10;
  scroller_x = scroller_start_x;
  scroller_x00 = 0;
  scroller_y = 18;
  scroller_dx00 = -50;
  scroller_line = random(POEM_COUNT);
  scroller_str = poems[scroller_line].body;
  scroller_next_line = false;
  
  display.setRotation(0);

  scroller_last_ms = millis();
}

void loopscroller() {
  long tick_ms = (long)(millis() - scroller_last_ms);
  if (scroller_next_line) {
    scroller_next_line = false;
    scroller_x = scroller_start_x;
    scroller_line = (scroller_line + 1) % POEM_COUNT;
    scroller_str = poems[scroller_line].body;
  }
  while (tick_ms > scroller_ms) {
    tickscroller();
    tick_ms -= scroller_ms;
    scroller_last_ms += scroller_ms;
  }
  drawscroller();
}

void tickscroller() {
  int x00 = scroller_x * 100 + scroller_x00 + scroller_dx00; // smooth horizontal
  scroller_x00 = x00 % 100; // preserve partial horizontal pixel
  scroller_x = (x00 - scroller_x00) / 100; // floor new horizontal
}

void drawscroller() {
  display.setRotation(3);
  display.setFont(&FreeSerif12pt7b);

  display.setCursor(scroller_x, scroller_y);     // Start at top-left corner

  const char* printing_str = scroller_str;
  int x = display.getCursorX();
  while(x < 0 && printing_str[0] != 0) { // if offscreen with text to show
    display.write(printing_str[0]); // print first char
    printing_str += 1; // don't print it again
    x = display.getCursorX(); // learn new horizontal

    if (x < 0) { // if still offscreen
      scroller_str = printing_str; // forget that char
      scroller_x = x; // and we have a new start position
    }
  }
  //display.print(printing_str);
  while(display.getCursorX() < display.width() && printing_str[0] != 0) {
    display.write(printing_str[0]);
    printing_str += 1;
  }

  if (display.getCursorX() < 0) {
    scroller_next_line = true;
  }

  display.setCursor(0, display.height() - 9);
  display.setFont(&Picopixel);

  int16_t x1, y1;
  uint16_t cx, cy;
  display.getTextBounds(
    poems[scroller_line].title2,
    0, 0, &x1, &y1, &cx, &cy);
  x1 = (display.width() - (int)cx) / 2;
  if (x1 < 0) {
    x1 = 0;
  }
  y1 = display.height() - (y1 + cy);
  display.setCursor(x1, y1);    
  display.println(poems[scroller_line].title2);

  display.getTextBounds(
    poems[scroller_line].title1,
    0, 0, &x1, &y1, &cx, &cy);
  x1 = (display.width() - (int)cx) / 2;
  if (x1 < 0) {
    x1 = 0;
  }
  y1 = display.height() - (y1 + cy * 2);
  display.setCursor(x1, y1);    
  display.println(poems[scroller_line].title1);

  display.setRotation(0);
}
